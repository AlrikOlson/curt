load p = (fs.read p).json
cfg = load "app.cfg" ? {}
print cfg["port"] ? 8080
