type Pt = {x float, y float}
dist a b = ((a.x-b.x)**2 + (a.y-b.y)**2).sqrt
print dist Pt{x:0, y:0} Pt{x:3, y:4}
