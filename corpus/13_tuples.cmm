minmax xs = (xs.min, xs.max)
(lo, hi) = minmax [3,1,4,1,5]
print "{lo} {hi}"
