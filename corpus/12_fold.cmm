print [1,2,3,4].fold 0 acc x -> acc + x
